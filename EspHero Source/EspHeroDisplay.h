// EspHeroDisplay.h

#ifndef ESPHERODISPLAY_H
#define ESPHERODISPLAY_H
#include <Arduino.h>
#include <U8g2lib.h>

#ifdef U8X8_HAVE_HW_SPI
#include <SPI.h>
#endif
#ifdef U8X8_HAVE_HW_I2C
#include <Wire.h>
#endif


U8G2_SSD1306_128X64_NONAME_F_SW_I2C u8g2(U8G2_R0, /* clock=*/ SCL, /* data=*/ SDA, /* reset=*/ U8X8_PIN_NONE);   // All Boards without Reset of the Display

int lastScreenNumber = 0;

static const int SCREENUMBER_CONNECT_INSTRUMENT = 1;
static const int SCREENUMBER_CONNECT_BLUETOOTH = 2;
static const int SCREENUMBER_LETSROCK = 3;
static const int SCREENUMBER_LOST_INSTRUMENT = 4;

static const unsigned char image_fail[] = {0xc0,0x0f,0x00,0xf0,0x3f,0x00,0xf8,0x7f,0x00,0xfc,0xff,0x00,0xce,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0x0f,0x00};
static const unsigned char image_splashScreen[] = {0x00,0x00,0x00,0x00,0x00,0x00,0x00,0x00,0x00,0x00,0x00,0x00,0x00,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0x00,0x00};
static const unsigned char image_battery_1[] = {0x00,0x00,0x00,0xf0,0xff,0x7f,0x08,0x00,0x80,0x08,0x00,0xb0,0x0e,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0x00,0x00};
static const unsigned char image_battery_2[] = {0x00,0x00,0x00,0xf0,0xff,0x7f,0x08,0x00,0x80,0x08,0x00,0xb6,0x0e,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0x00,0x00};
static const unsigned char image_battery_3[] = {0x00,0x00,0x00,0xf0,0xff,0x7f,0x08,0x00,0x80,0x08,0xc0,0xb6,0x0e,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0x00,0x00};
static const unsigned char image_battery_4[] = {0x00,0x00,0x00,0xf0,0xff,0x7f,0x08,0x00,0x80,0x08,0xd8,0xb6,0x0e,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0x00,0x00};
static const unsigned char image_battery_5[] = {0x00,0x00,0x00,0xf0,0xff,0x7f,0x08,0x00,0x80,0x08,0xdb,0xb6,0x0e,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0x00,0x00};
static const unsigned char image_battery_6[] = {0x00,0x00,0x00,0xf0,0xff,0x7f,0x08,0x00,0x80,0x68,0xdb,0xb6,0x6e,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0x00,0x00};
static const unsigned char image_signal[] = {0xe0,0x03,0xf8,0x0f,0x7c,0x1f,0x7e,0x3e,0x6e,0x3d,0x5f,0x7b,0x3f,0x7d,0x7f,0x7e,0x3f,0x7d,0x5f,0x7b,0x6e,0x3d,0x7e,0x3e,0x7c,0x1f,0xf8,0x0f,0xe0,0x03};
static const unsigned char image_devil[] = {0x0c,0xc0,0x00,0x06,0x80,0x01,0x07,0x80,0x03,0xcf,0xcf,0x03,0xff,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0x0f,0x00};
static const unsigned char image_battery_unknown1[] = {0x1e,0x33,0x33,0x30,0x18,0x0c,0x00,0x0c};
static const unsigned char image_battery_unknown2[] = {0x00,0x00,0x00,0xf0,0xff,0x7f,0x08,0x00,0x80,0x08,0x00,0x80,0x0e,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0x00,0x00};



void drawSplashScreen(void) {
  u8g2.clearBuffer();
  u8g2.setFontMode(1);
  u8g2.setBitmapMode(1);
  u8g2.drawXBM(-3, -1, 136, 64, image_splashScreen);
  u8g2.sendBuffer();
}

void displayInitialize(){
  if (DEBUG) Serial.println("Initialize Displayed...");
  u8g2.begin();
  drawSplashScreen();
  delay(3000);
  if (DEBUG) Serial.println("Displayed Initialized Succesfully!");
}
void drawBattery(){

  
  if(batteryLevel == 1){
    u8g2.drawXBM(101, 1, 24, 16, image_battery_1);
  }else if(batteryLevel == 2){
   u8g2.drawXBM(101, 1, 24, 16, image_battery_2);
  }else if(batteryLevel == 3){
   u8g2.drawXBM(101, 1, 24, 16, image_battery_3);
  }else if(batteryLevel == 4){
   u8g2.drawXBM(101, 1, 24, 16, image_battery_4);
  }else if(batteryLevel== 5){
   u8g2.drawXBM(101, 1, 24, 16, image_battery_5);
  }else if(batteryLevel == 6){
   u8g2.drawXBM(101, 1, 24, 16, image_battery_6);
  }else{
    u8g2.drawXBM(112, 4, 7, 8, image_battery_unknown1);
    u8g2.drawXBM(102, 1, 24, 16, image_battery_unknown2);

  }
}
void drawUI(){
    u8g2.drawBox(-19, 0, 147, 17);
    u8g2.setDrawColor(2);
    u8g2.setFont(u8g2_font_t0_16b_tr);
    u8g2.drawStr(3, 13, "by Malware 2.2");
}

void drawMessage(){
  if (DEBUG) Serial.println("Drawing Message");
  u8g2.setFont(u8g2_font_profont15_tr);
  if(screenNumber == SCREENUMBER_CONNECT_INSTRUMENT){
    if (DEBUG) Serial.println("Drawing SCREENUMBER_CONNECT_INSTRUMENT");
    u8g2.drawStr(43, 50, "instrument");
    u8g2.drawStr(54, 37, "Connect");   
    u8g2.drawXBM(21, 30, 18, 18, image_fail);
    
  }else if(screenNumber == SCREENUMBER_CONNECT_BLUETOOTH){
    if (DEBUG) Serial.println("Drawing SCREENUMBER_CONNECT_BLUETOOTH");      
    u8g2.drawStr(49, 50, "bluetooth");
    u8g2.drawStr(57, 37, "Connect");
    u8g2.drawXBM(24, 31, 15, 15, image_signal);
    
  }else if(screenNumber == SCREENUMBER_LETSROCK){    
    if (DEBUG) Serial.println("Drawing SCREENUMBER_LETSROCK");   
    u8g2.drawStr(63, 50, "rock!");
    u8g2.drawStr(53, 35, "Ready to");   
    u8g2.drawXBM(23, 27, 18, 21, image_devil);
    
  }else if(screenNumber == SCREENUMBER_LOST_INSTRUMENT){
    if (DEBUG) Serial.println("Drawing SCREENUMBER_LOST_INSTRUMENT");
    u8g2.drawStr(43, 50, "instrument");
    u8g2.drawStr(54, 37, "Connect");   
    u8g2.drawXBM(21, 30, 18, 18, image_fail);
  }

    
    
}

void drawScreen(void) { 
  if(lastScreenNumber != screenNumber){
    if (DEBUG) Serial.println("Screen Update");
    u8g2.clearBuffer();
    u8g2.setFontMode(1);
    u8g2.setBitmapMode(1);
    drawMessage();
    drawBattery();
    drawUI();
    u8g2.sendBuffer(); 
    lastScreenNumber = screenNumber;
    guitar.begin();
  }else{
      
  }
}


#endif
